## main/Kconfig.projbuild
```kconfig
menu "Roller Shutter Configuration"
    config PULSE_COUNTER_PIN
        int "Pulse Counter GPIO Pin"
        default 18
        help
            GPIO pin connected to the hall sensor for pulse counting.

    config MOTOR_UP_PIN
        int "Motor UP Signal GPIO Pin"
        default 17
        help
            GPIO pin to monitor if the motor is moving UP.

    config MOTOR_DOWN_PIN
        int "Motor DOWN Signal GPIO Pin"
        default 16
        help
            GPIO pin to monitor if the motor is moving DOWN.

    config BUTTON_UP_PIN
        int "Button UP Control GPIO Pin"
        default 21
        help
            GPIO pin to simulate a button press for moving UP.

    config BUTTON_DOWN_PIN
        int "Button DOWN Control GPIO Pin"
        default 22
        help
            GPIO pin to simulate a button press for moving DOWN.
endmenu
```

## sdkconfig.defaults
```kconfig
# =================================================
# Matter für ESP32 Classic (ohne OpenThread)
# =================================================

CONFIG_IDF_TARGET="esp32"

CONFIG_ESP_MAIN_TASK_STACK_SIZE=8192

# === ARDUINO COMPATIBILITY ===
CONFIG_FREERTOS_HZ=1000
CONFIG_AUTOSTART_ARDUINO=y
CONFIG_ENABLE_ARDUINO_DEPENDS=y

# === LOG LEVELS ===
CONFIG_BOOTLOADER_LOG_LEVEL_ERROR=y
CONFIG_ARDUHAL_LOG_DEFAULT_LEVEL_INFO=y
CONFIG_LOG_DEFAULT_LEVEL_ERROR=y

# === SERIAL/FLASH COMPATIBILITY ===
CONFIG_ESPTOOLPY_BAUD_921600B=y
CONFIG_ESPTOOLPY_BAUD=921600
CONFIG_ESPTOOLPY_COMPRESSED=y
CONFIG_ESPTOOLPY_MONITOR_BAUD_115200B=y
CONFIG_ESPTOOLPY_MONITOR_BAUD=115200
CONFIG_ESPTOOLPY_FLASHSIZE_4MB=y
CONFIG_ESPTOOLPY_FLASHMODE_DIO=y
CONFIG_ESPTOOLPY_FLASHFREQ_40M=y

# === BLE Configuration (erweitert für Shelly Integration) ===
CONFIG_BT_ENABLED=y
CONFIG_BT_NIMBLE_ENABLED=y
CONFIG_BT_CONTROLLER_ENABLED=y

# BT Controller Mode
CONFIG_BTDM_CTRL_MODE_BLE_ONLY=y
# CONFIG_BTDM_CTRL_MODE_BR_EDR_ONLY is not set
# CONFIG_BTDM_CTRL_MODE_BTDM is not set

# Bluedroid disabled (we use NimBLE)
# CONFIG_BT_BLUEDROID_ENABLED is not set
# CONFIG_BT_CLASSIC_ENABLED is not set

# NimBLE Configuration
CONFIG_BT_NIMBLE_MAX_CONNECTIONS=5
CONFIG_BT_NIMBLE_HCI_EVT_BUF_SIZE=70
CONFIG_BT_NIMBLE_MAX_BONDS=3
CONFIG_BT_NIMBLE_MAX_CCCDS=8
CONFIG_BT_NIMBLE_ROLE_CENTRAL=y
CONFIG_BT_NIMBLE_ROLE_OBSERVER=y

CONFIG_BT_NIMBLE_TASK_STACK_SIZE=8192
CONFIG_BT_NIMBLE_HOST_TASK_STACK_SIZE=8192
CONFIG_NIMBLE_HOST_TASK_STACK_SIZE=8192

# Do not Use BLE for commissioning
CONFIG_USE_BLE_ONLY_FOR_COMMISSIONING=n

# === mbedTLS für BTHome Encryption ===
CONFIG_MBEDTLS_CCM_C=y
CONFIG_MBEDTLS_AES_C=y

# === LWIP/NETWORK ===
CONFIG_LWIP_IPV6_AUTOCONFIG=y
CONFIG_LWIP_IPV6_NUM_ADDRESSES=6
CONFIG_LWIP_HOOK_IP6_ROUTE_DEFAULT=y
CONFIG_LWIP_HOOK_ND6_GET_GW_DEFAULT=y

# === PARTITION TABLE ===
CONFIG_PARTITION_TABLE_CUSTOM=y
CONFIG_PARTITION_TABLE_FILENAME="partitions.csv"
CONFIG_PARTITION_TABLE_OFFSET=0x9000

# === MATTER CONFIGURATION ===
# Disable chip shell
# CONFIG_ENABLE_CHIP_SHELL is not set

# Disable OTA Requester
# CONFIG_ENABLE_OTA_REQUESTOR is not set

# Disable secure cert DS peripheral
# CONFIG_ESP_SECURE_CERT_DS_PERIPHERAL is not set

# Use compact attribute storage
CONFIG_ESP_MATTER_NVS_USE_COMPACT_ATTR_STORAGE=y

# === MATTER CONSOLE - DEAKTIVIEREN ===
# CONFIG_ESP_MATTER_CONSOLE_ENABLE is not set

# === OPENTHREAD - KOMPLETT DEAKTIVIEREN ===
# (ESP32 Classic unterstützt kein OpenThread)
# CONFIG_OPENTHREAD_ENABLED is not set
# CONFIG_OPENTHREAD_SRP_CLIENT is not set
# CONFIG_OPENTHREAD_DNS_CLIENT is not set
# CONFIG_OPENTHREAD_LOG_LEVEL_DYNAMIC is not set
# CONFIG_OPENTHREAD_LOG_LEVEL_NOTE is not set
# CONFIG_OPENTHREAD_CLI is not set
# CONFIG_OPENTHREAD_BORDER_ROUTER is not set
# CONFIG_OPENTHREAD_FTD is not set
# CONFIG_OPENTHREAD_MTD is not set
# CONFIG_OPENTHREAD_RADIO is not set

# === WIFI CONFIGURATION ===
# Disable softAP by default
# CONFIG_ESP_WIFI_SOFTAP_SUPPORT is not set
CONFIG_ENABLE_WIFI_STATION=y
# CONFIG_ENABLE_WIFI_AP is not set

# === MBEDTLS ===
CONFIG_MBEDTLS_HKDF_C=y

# === LIBSODIUM ===
CONFIG_LIBSODIUM_USE_MBEDTLS_SHA=y

# === FREERTOS COMPATIBILITY ===
CONFIG_FREERTOS_ENABLE_BACKWARD_COMPATIBILITY=y

# === MDNS ===
CONFIG_USE_MINIMAL_MDNS=y
CONFIG_ENABLE_EXTENDED_DISCOVERY=y

# === GPIO CONFIGURATION (ESP32 D1 Mini) ===
CONFIG_BUTTON_PIN=0
CONFIG_WS2812_PIN=2
CONFIG_ENV_GPIO_RANGE_MIN=0
CONFIG_ENV_GPIO_RANGE_MAX=39
CONFIG_ENV_GPIO_IN_RANGE_MAX=39
CONFIG_ENV_GPIO_OUT_RANGE_MAX=33

#
# Arduino Configuration
#
#
# Disable all Arduino included BLE libraries
#
CONFIG_ARDUINO_SELECTIVE_COMPILATION=y
# CONFIG_ARDUINO_SELECTIVE_WiFiProv is not set
# CONFIG_ARDUINO_SELECTIVE_BLE is not set
# CONFIG_ARDUINO_SELECTIVE_BluetoothSerial is not set
# CONFIG_ARDUINO_SELECTIVE_SimpleBLE is not set
# CONFIG_ARDUINO_SELECTIVE_Matter is not set
# end of Arduino Configuration

# Matter Device Configuration
CONFIG_CHIP_DEVICE_VENDOR_ID=0xFFF1
CONFIG_CHIP_DEVICE_PRODUCT_ID=0x8000
CONFIG_CHIP_DEVICE_DISCRIMINATOR=3840
CONFIG_CHIP_DEVICE_SETUP_PIN_CODE=34970112
CONFIG_CHIP_DEVICE_SOFTWARE_VERSION=1
CONFIG_CHIP_DEVICE_SOFTWARE_VERSION_STRING="1.3.0"
CONFIG_CHIP_DEVICE_PRODUCT_NAME="BeltWinder Shutter"
CONFIG_CHIP_DEVICE_PRODUCT_URL="https://github.com/Robothaler/BeltWinder-Matter"
```
